## config/west.yml
```yaml
manifest:
  remotes:
    - name: cormoran
      url-base: https://github.com/cormoran
    - name: badjeff    # <-- PMW3610
      url-base: https://github.com/badjeff
    - name: caksoylar  # <-- RGB LED
      url-base: https://github.com/caksoylar
    - name: takamaru-fpv  # <-- Battery level smoothing
      url-base: https://github.com/takamaru-fpv

  projects:
    # ZMK: DYA Studio 用カスタム RPC サブシステム付き cormoran fork
    - name: zmk
      remote: cormoran
      # 依存をブランチ追従にすると上流更新で API 不整合(bit rot)を起こすため、
      # 2026-05-13 のビルド成功時点の commit に固定する。
      revision: 4493783ef88ce2e653bf8217c92ee17140df71e3  # 旧: v0.3-branch+dya (2026-05-04)
      import: app/west.yml
    - name: zmk-feature-non-lipo-battery-management
      remote: takamaru-fpv
      revision: fa7e8888021bcc62dbc288dc2efe4b2bc3071d1f  # 旧: voltage_division (2026-03-22)

    # DYA Studio モジュール（すべて cormoran リポジトリ）
    - name: zmk-module-ble-management
      remote: cormoran
      revision: 851661cd21f2aded8ec649da86e01a207dc4b973  # 旧: main (2026-02-06)
    - name: zmk-module-battery-history
      remote: cormoran
      revision: 307755dd2ad4d320e14de162e8e5ef018f29d929  # 旧: main (2026-02-24)
    - name: zmk-module-settings-rpc
      remote: cormoran
      revision: ad1c995cf910ca989ecd6352a1d0b41ccb18362c  # 旧: main (2026-02-11)
    - name: zmk-module-runtime-input-processor
      remote: cormoran
      # ZMK v4 移行 commit(e643dfe3)で zmk_keymap_layer_activate が 2 引数化され、
      # 旧 v0.3 fork(1 引数)と不整合になりビルドが壊れたため、移行前に固定する。
      revision: dbf92f764de8b6ffd60bf5850514302875fe2570  # 旧: main (2026-02-24)
    - name: zmk-pmw3610-driver
      remote: badjeff
      revision: 5c5af40de4d8cdf55dc63c4c5907af1e52da6a95  # 旧: zmk-0.3 (2025-12-16)
    - name: zmk-rgbled-widget
      remote: caksoylar
      revision: 8756cb7b8114069fa3c25c6f6c990f24988fceff  # 旧: v0.3-branch (2026-02-16)
  self:
    path: config
```
